## components/cything/Kconfig.projbuild
```kconfig
menu "Example Configuration"

    config MQTT_BROKER_PORT
        int "Port of the MQTT broker use"
        default 8883
        help
            In general, port 8883 is for secured MQTT connections.
            Port 443 requires use of the ALPN TLS extension with the ALPN protocol name.
            When using port 8883, ALPN is not required.

    config HARDWARE_PLATFORM_NAME
        string "The hardware platform"
        default "ESP32"
        help
            The name of the hardware platform the application is running on.

    config MQTT_NETWORK_BUFFER_SIZE
        int "Size of the network buffer for MQTT packets"
        range 1024 2048
        default 1024
        help
            Size of the network buffer for MQTT packets.

endmenu

menu "coreMQTT"

    config MQTT_STATE_ARRAY_MAX_COUNT
        int "Max Incoming/Outgoing Publish Messages Pending ACK"
        default 10
        range 0 4294967295
        help
            Maximum number of MQTT PUBLISH messages pending acknowledgment at a
            time, for incoming and outgoing direction separately (QoS 1/2).
            2 * MQTT_STATE_ARRAY_MAX_COUNT state records are statically allocated.

    config MQTT_MAX_CONNACK_RECEIVE_RETRY_COUNT
        int "Max CONNACK Retries"
        default 5
        range 0 65535
        help
            Retries for receiving CONNACK when MQTT_Connect is called with
            timeoutMs = 0.

    config MQTT_PINGRESP_TIMEOUT_MS
        int "Ping Response Timeout Milliseconds"
        default 5000
        help
            Maximum milliseconds to wait for a ping response; on expiry
            MQTT_ProcessLoop returns MQTTKeepAliveTimeout.

    config MQTT_RECV_POLLING_TIMEOUT_MS
        int "MQTT Packet Receive Polling Timeout"
        default 10
        range 0 4294967295
        help
            Maximum duration between non-empty network reads while receiving
            one MQTT packet; on expiry MQTT_ProcessLoop returns MQTTRecvFailed.
            Also bounds how quickly the idle process loop returns, which is
            what makes the 100 ms mqtt_response_fifo drain period possible
            (doc/send-buffers.md).

    config MQTT_SEND_TIMEOUT_MS
        int "MQTT Send Timeout Milliseconds"
        default 20000
        range 0 4294967295
        help
            Maximum duration allowed to send one MQTT packet over the transport.

    menu "Logging"

        config CORE_MQTT_LOG_ERROR
            bool "Enable Error Logging"
            default y

        config CORE_MQTT_LOG_WARN
            bool "Enable Warning Logging"
            default n

        config CORE_MQTT_LOG_INFO
            bool "Enable Info Logging"
            default y

        config CORE_MQTT_LOG_DEBUG
            bool "Enable Debug Logging"
            default n

    endmenu # coreMQTT Logging

endmenu # coreMQTT
```

## sdkconfig.defaults.16mb
```kconfig
# idf.py -DSDKCONFIG_DEFAULTS="sdkconfig.defaults;sdkconfig.defaults.16mb" reconfigure
CONFIG_ESPTOOLPY_FLASHSIZE_16MB=y
CONFIG_ESPTOOLPY_FLASHSIZE="16MB"
CONFIG_PARTITION_TABLE_CUSTOM_FILENAME="partitions/cything-16MB.csv"
CONFIG_PARTITION_TABLE_FILENAME="partitions/cything-16MB.csv"
```

## sdkconfig.defaults.8mb
```kconfig
# idf.py -DSDKCONFIG_DEFAULTS="sdkconfig.defaults;sdkconfig.defaults.8mb" reconfigure
CONFIG_ESPTOOLPY_FLASHSIZE_8MB=y
CONFIG_ESPTOOLPY_FLASHSIZE="8MB"
CONFIG_PARTITION_TABLE_CUSTOM_FILENAME="partitions/cything-8MB.csv"
CONFIG_PARTITION_TABLE_FILENAME="partitions/cything-8MB.csv"
```
